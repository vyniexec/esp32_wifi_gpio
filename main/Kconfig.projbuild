## main/Kconfig.projbuild
```kconfig
menu "Configuração da REDE"

    config ESP_WIFI_SSID
        string "WiFi SSID"
        default "NOME_DA_REDE"
        help
            SSID (nome da rede) para a qual se conectar.

    config ESP_WIFI_PASSWORD
        string "WiFi Password"
        default "SENHA_DA_REDE"
        help
            WiFi senha (WPA ou WPA2) a qual se conectar.

    config ESP_MAXIMUM_RETRY
        string "5"
        default 5
        help
            Defina o numero de tentiva para se reconectar caso for necessaria.
endmenu
```
